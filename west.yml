## west.yml
```yaml
# The west manifest file for rt595 microej

manifest:
  remotes:
    - name: nxp-mcuxpresso
      url-base: https://github.com/nxp-mcuxpresso
  # Please add items below in reverse alphabetical order
  projects:
    - name: mcux-sdk
      remote: nxp-mcuxpresso
      revision: MCUX_2.12.0
      path: nxp-vee-rt595/nxpvee-mimxrt595-evk-round-bsp/mcux-sdk/core
    - name: FreeRTOS-Kernel
      revision: MCUX_2.12.0
      remote: nxp-mcuxpresso
      path: nxp-vee-rt595/nxpvee-mimxrt595-evk-round-bsp/mcux-sdk/rtos/freertos/freertos-kernel
  self:
    path: nxp-vee-rt595
```
